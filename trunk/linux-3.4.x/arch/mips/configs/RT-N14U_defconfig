## trunk/linux-3.4.x/arch/mips/configs/RT-N14U_defconfig
```kconfig
# ASUS RT-N14U / MT7620
CONFIG_MIPS=y
CONFIG_CPU_MIPS32=y
CONFIG_CPU_MIPS32_R1=y
CONFIG_CPU_LITTLE_ENDIAN=y

CONFIG_RALINK=y
CONFIG_SOC_MT7620=y
CONFIG_RALINK_MT7620=y
CONFIG_MACH_MT7620=y

CONFIG_PAGE_SIZE_4KB=y
CONFIG_HZ=250
CONFIG_PREEMPT_NONE=y

CONFIG_HIGHMEM=y
CONFIG_FLATMEM=y

CONFIG_CMDLINE_BOOL=y
CONFIG_CMDLINE="console=ttyS0,57600"
CONFIG_CMDLINE_OVERRIDE=y

CONFIG_MTD=y
CONFIG_MTD_BLOCK=y
CONFIG_MTD_CMDLINE_PARTS=y
CONFIG_MTD_SPI_NOR=y

CONFIG_JFFS2_FS=y
CONFIG_SQUASHFS=y
CONFIG_SQUASHFS_LZMA=y

CONFIG_NET=y
CONFIG_INET=y
CONFIG_BRIDGE=y

CONFIG_SERIAL_8250=y
CONFIG_SERIAL_8250_CONSOLE=y

CONFIG_USB=y
CONFIG_USB_EHCI_HCD=y
CONFIG_USB_OHCI_HCD=y

CONFIG_MTD_SPI_NOR=y
CONFIG_SPI=y
CONFIG_SPI_MASTER=y
CONFIG_SPI_RALINK=y

CONFIG_NETDEVICES=y
CONFIG_ETHERNET=y
CONFIG_NET_VENDOR_RALINK=y
CONFIG_RALINK_ETH=y
CONFIG_RALINK_ESW=y

CONFIG_WATCHDOG=y
CONFIG_RALINK_WDT=y
```
